## src/Kconfig.projbuild
```kconfig
# SonicSync32 application configuration.
# All tuning values below are adjustable at build time:
#   pio run -t menuconfig  ->  "SonicSync32 Configuration"
menu "SonicSync32 Configuration"

    config SONICSYNC_SAMPLE_RATE
        int "I2S microphone sample rate (Hz)"
        range 8000 48000
        default 16000
        help
            Sample rate of the INMP441 I2S receive interface.
            16000 Hz gives a 0..8 kHz analysis range and is plenty
            for the bass (40-250 Hz) and voice (300-3400 Hz) bands.

    config SONICSYNC_I2S_BCLK_GPIO
        int "INMP441 SCK/BCLK GPIO"
        range 0 30
        default 6

    config SONICSYNC_I2S_WS_GPIO
        int "INMP441 WS/LRCLK GPIO"
        range 0 30
        default 7

    config SONICSYNC_I2S_DATA_GPIO
        int "INMP441 SD (mic data into ESP32) GPIO"
        range 0 30
        default 10

    config SONICSYNC_LED_GREEN_GPIO
        int "Green LED driver GPIO"
        range 0 30
        default 18

    config SONICSYNC_LED_BLUE_GPIO
        int "Blue LED driver GPIO"
        range 0 30
        default 19

    config SONICSYNC_BASS_LOW_HZ
        int "Bass band low edge (Hz)"
        range 1 20000
        default 40
        help
            Blue skips the lowest selected FFT bin when its center falls
            below this edge, so sub-band rumble (fan blade-pass at ~31 Hz
            with a 40 Hz edge on the 16 kHz / 512-sample grid) cannot gate
            blue. Green and the capture/FFT settings are unchanged.

    config SONICSYNC_BASS_HIGH_HZ
        int "Bass band high edge (Hz)"
        range 1 20000
        default 250

    config SONICSYNC_VOICE_LOW_HZ
        int "Voice band low edge (Hz)"
        range 1 20000
        default 300

    config SONICSYNC_VOICE_HIGH_HZ
        int "Voice band high edge (Hz)"
        range 1 20000
        default 3400

    config SONICSYNC_FFT_SIZE
        int "FFT block size (samples, power of two)"
        range 64 1024
        default 512
        help
            Larger blocks give finer frequency resolution and more
            stable levels; smaller blocks react faster.

    config SONICSYNC_NOISE_GATE_DB
        int "Noise gate threshold (dBFS RMS)"
        range -90 0
        default -50
        help
            Band RMS level relative to full-scale PCM. Level below
            this is treated as silence and forces the
            corresponding LED channel to zero. Tune so that room
            noise stays below the gate.

    config SONICSYNC_GATE_HYSTERESIS_DB
        int "Noise gate hysteresis (dB)"
        range 0 20
        default 3
        help
            Level must exceed gate+hysteresis to turn on, and drop
            below gate to turn off. Prevents flicker.

    config SONICSYNC_BASS_GATE_OFFSET_DB
        int "Bass gate offset above the base gate (dB)"
        range 0 40
        default 10
        help
            Blue uses a higher gate than green. At the default base
            gate of -50 dBFS, an offset of 10 gives -40 dBFS minimum.

    config SONICSYNC_BASS_GATE_HYSTERESIS_DB
        int "Bass gate hysteresis (dB)"
        range 0 20
        default 5

    config SONICSYNC_BASS_CONFIRM_MS
        int "Bass trigger confirmation time (ms)"
        range 0 250
        default 64
        help
            Bass must stay above its opening threshold for this long.
            Rejects isolated one-frame spikes; 64 ms is two blocks at
            the default sample rate/FFT size. Quiet still forces OFF.

    config SONICSYNC_BASS_CALIBRATION_MS
        int "Bass background calibration after readiness (ms)"
        range 0 5000
        default 1500
        help
            Keep music off briefly after the readiness animation.
            Blue stays OFF while measuring the background bass level.
            Green remains responsive. Zero disables startup calibration.

    config SONICSYNC_BASS_NOISE_MARGIN_DB
        int "Bass gate margin above learned background (dB)"
        range 0 30
        default 8
        help
            The effective bass gate is the higher of base+offset and
            learned background+margin. The calibrated gate is retained
            as a lower bound so quiet gaps cannot increase sensitivity.
            Reboot in quiet to recalibrate after moving to another room.

    config SONICSYNC_BASS_DIAGNOSTIC_TRACE
        int "Blue diagnostic transition logging (0=off, 1=on)"
        range 0 1
        default 0
        help
            Log each detector transition with level, gate, calibrated
            minimum, nearest FFT peak-bin frequency and bass energy share.
            Green processing and all audio capture settings are unchanged.

    config SONICSYNC_BASS_DIAGNOSTIC_FORCE_OFF
        int "Blue diagnostic forced OFF (0=normal, 1=force off)"
        range 0 1
        default 0
        help
            Temporarily force only blue's normal-operation PWM to zero.
            Green stays operational. If blue physically flickers while
            its commanded output is zero, investigate the driver/wiring.
            Set this back to zero before acceptance testing or publishing
            a production configuration. Forced-off is not a bass fix.

    config SONICSYNC_BASS_SENSITIVITY
        int
        default 60
        help
            Legacy saved setting accepted for configuration compatibility.
            Blue now switches between OFF and maximum configured brightness.

    config SONICSYNC_VOICE_SENSITIVITY
        int "Green brightness response (percent)"
        range 10 200
        default 85
        help
            A modest reduction from 100; voice detection is unchanged.
            Lower values darken intermediate levels, retaining the
            configured full-brightness endpoint.

    config SONICSYNC_NORMALIZE_HEADROOM_DB
        int "Green loud-music normalization headroom (dB)"
        range 0 12
        default 3
        help
            Lift green's full-brightness reference above loud voice-band
            input so sustained party music does not pin green at maximum.
            Never raises sensitivity for quiet audio or background noise.
            Blue bypasses brightness normalization and stays binary.

    config SONICSYNC_NORMALIZE_ATTACK_MS
        int "Green loud-music normalization attack (ms)"
        range 10 2000
        default 150

    config SONICSYNC_NORMALIZE_RELEASE_MS
        int "Green loud-music normalization release (ms)"
        range 250 20000
        default 4000
        help
            Slow recovery of the brightness reference after loud music
            avoids rapid gain pumping. Does not delay silence-to-OFF.

    config SONICSYNC_FULL_SCALE_DB
        int "Green base span from gate to full brightness (dB)"
        range 1 120
        default 38
        help
            The base full-brightness reference is base gate + span dB.
            Loud-music normalization can raise this reference, without
            changing either channel's detection threshold.

    config SONICSYNC_SENSITIVITY
        int "Green master brightness sensitivity (percent)"
        range 10 500
        default 100
        help
            Multiplier applied to green's brightness mapping. 100 = 1x.
            Blue bypasses this control and uses the configured maximum.

    config SONICSYNC_GAMMA
        int "Green brightness gamma (percent, 100 = linear)"
        range 10 400
        default 180
        help
            Brightness curve exponent. >100 reduces mid-level duty;
            <100 increases it. 100 gives a linear mapping.

    config SONICSYNC_ATTACK_MS
        int
        default 60
        help
            Legacy saved setting accepted for configuration compatibility.
            Use the independent green speech-envelope setting below.

    config SONICSYNC_RELEASE_MS
        int
        default 300
        help
            Legacy saved setting accepted for configuration compatibility.

    config SONICSYNC_VOICE_ATTACK_MS
        int "Green speech-envelope attack (ms)"
        range 1 1000
        default 15
        help
            Faster rise for speech syllables. New setting so an existing
            sdkconfig's old 60 ms attack does not override this default.
            The output update interval is still one FFT block (32 ms).

    config SONICSYNC_VOICE_RELEASE_MS
        int "Green speech-envelope release (ms)"
        range 1 2000
        default 90
        help
            Shorter decay follows articulation instead of hanging between
            phrases. A closed voice gate still forces immediate OFF.

    config SONICSYNC_MAX_BRIGHTNESS
        int "Maximum LED brightness (0-4095)"
        range 0 4095
        default 4095
        help
            Full-scale PWM duty of the 12-bit LEDC outputs.

    config SONICSYNC_ANIM_BRIGHTNESS
        int "Readiness animation brightness (0-4095)"
        range 0 4095
        default 1023
        help
            Reduced brightness used for the one-time boot readiness
            animation (about 25% by default).

    config SONICSYNC_LED_PWM_FREQ
        int "LED PWM frequency (Hz)"
        range 100 25000
        default 1000
        help
            PWM frequency for both LED driver outputs.

endmenu
```
